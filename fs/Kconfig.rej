## fs/Kconfig.rej
```kconfig
--- fs/Kconfig
+++ fs/Kconfig
@@ -280,6 +280,12 @@ endif # NETWORK_FILESYSTEMS
 source "fs/nls/Kconfig"
 source "fs/dlm/Kconfig"
 
+config DYNAMIC_FSYNC
+	bool "dynamic file sync control"
+	default n
+	help
+	  An experimental file sync control using new power_suspend driver 
+
 config AIO_OPTIMIZATION
 	bool "AIO kernel optimization patches"
 	default y
```
